## conf/layer.conf
```bitbake
# We have a conf and classes directory, add to BBPATH
BBPATH .= ":${LAYERDIR}"

# We have recipes-* directories, add to BBFILES
BBFILES += "${LAYERDIR}/recipes-*/*/*.bb \
            ${LAYERDIR}/recipes-*/*/*.bbappend \
            "

BBFILE_COLLECTIONS += "meta-training"
BBFILE_PATTERN_meta-training = "^${LAYERDIR}/"
BBFILE_PRIORITY_meta-training = "6"

LAYERDEPENDS_meta-training = "core"
LAYERSERIES_COMPAT_meta-training = "hardknott"
```
